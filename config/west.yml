## config/west.yml
```yaml
manifest:
  remotes:
      # zmk fork
    - name: rayreside
      url-base: https://github.com/rayreside
      # bravekarma
    - name: caksoylar
      url-base: https://github.com/caksoylar
  projects:
    - name: zmk
      remote: rayreside
      revision: main
      import: app/west.yml
  self:
    path: config
```
