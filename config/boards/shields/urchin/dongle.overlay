#include <dt-bindings/zmk/matrix_transform.h>
#include "urchin.dtsi"

/ {
    kscan0: kscan {        
        compatible = "zmk,kscan-gpio-matrix";
        label = "KSCAN0";
    };

    physical_layout0: physical_layout_0 {
        compatible = "zmk,physical-layout";
        display-name = "Default Layout";
        transform = <&default_transform>;
    };
};